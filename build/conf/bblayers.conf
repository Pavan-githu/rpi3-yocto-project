## build/conf/bblayers.conf
```bitbake
# POKY_BBLAYERS_CONF_VERSION is increased each time build/conf/bblayers.conf
# changes incompatibly
POKY_BBLAYERS_CONF_VERSION = "2"

BBPATH = "${TOPDIR}"
BBFILES ?= ""

BBLAYERS ?= " \
  /home/ubuntu/rpi3project/sources/poky/meta \
  /home/ubuntu/rpi3project/sources/poky/meta-poky \
  /home/ubuntu/rpi3project/sources/poky/meta-yocto-bsp \
  /home/ubuntu/rpi3project/sources/meta-raspberrypi \
  /home/ubuntu/rpi3project/sources/meta-openembedded/meta-oe \
  /home/ubuntu/rpi3project/sources/meta-userapp-package \
  "
```
